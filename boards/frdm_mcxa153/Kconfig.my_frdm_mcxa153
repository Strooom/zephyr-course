## boards/frdm_mcxa153/Kconfig.my_frdm_mcxa153
```kconfig
# Copyright 2025 NXP
# SPDX-License-Identifier: Apache-2.0

config BOARD_MY_FRDM_MCXA153
	select SOC_MCXA153 if BOARD_MY_FRDM_MCXA153
	select SOC_PART_NUMBER_MCXA153VLH
```

## boards/frdm_mcxa153/board.yml
```yaml
board:
  name: my_frdm_mcxa153
  full_name: FRDM-MCXA153 TRAINING
  vendor: nxp
  socs:
  - name: mcxa153
```

## twister-out/native_sim_native/host_gnu/app/tests/lib/circularbuffer/lib.circularbuffer/Kconfig/Kconfig.modules
```kconfig
menu "cmsis_6 (/home/strooom/projects/zephyr/iomicoZephyrCourse/modules/hal/cmsis_6)"
osource "$(ZEPHYR_CMSIS_6_KCONFIG)"
config ZEPHYR_CMSIS_6_MODULE
	bool
	default y
endmenu
menu "hal_espressif (/home/strooom/projects/zephyr/iomicoZephyrCourse/modules/hal/espressif)"
osource "$(ZEPHYR_HAL_ESPRESSIF_KCONFIG)"
config ZEPHYR_HAL_ESPRESSIF_MODULE
	bool
	default y

config ZEPHYR_HAL_ESPRESSIF_MODULE_BLOBS
	bool
endmenu
config ZEPHYR_HAL_STM32_MODULE
	bool
	default y

config ZEPHYR_HAL_STM32_MODULE_BLOBS
	bool
menu "segger (/home/strooom/projects/zephyr/iomicoZephyrCourse/modules/debug/segger)"
osource "$(ZEPHYR_SEGGER_KCONFIG)"
config ZEPHYR_SEGGER_MODULE
	bool
	default y
endmenu
```

## twister-out/native_sim_native/host_gnu/app/tests/lib/circularbuffer/lib.circularbuffer/Kconfig/arch/Kconfig.tmp
```kconfig
# Load Zephyr Arch Kconfig descriptions.
osource "/home/strooom/projects/zephyr/iomicoZephyrCourse/zephyr/arch/rx/Kconfig"
osource "/home/strooom/projects/zephyr/iomicoZephyrCourse/zephyr/arch/x86/Kconfig"
osource "/home/strooom/projects/zephyr/iomicoZephyrCourse/zephyr/arch/xtensa/Kconfig"
osource "/home/strooom/projects/zephyr/iomicoZephyrCourse/zephyr/arch/sparc/Kconfig"
osource "/home/strooom/projects/zephyr/iomicoZephyrCourse/zephyr/arch/riscv/Kconfig"
osource "/home/strooom/projects/zephyr/iomicoZephyrCourse/zephyr/arch/posix/Kconfig"
osource "/home/strooom/projects/zephyr/iomicoZephyrCourse/zephyr/arch/openrisc/Kconfig"
osource "/home/strooom/projects/zephyr/iomicoZephyrCourse/zephyr/arch/mips/Kconfig"
osource "/home/strooom/projects/zephyr/iomicoZephyrCourse/zephyr/arch/arm64/Kconfig"
osource "/home/strooom/projects/zephyr/iomicoZephyrCourse/zephyr/arch/arm/Kconfig"
osource "/home/strooom/projects/zephyr/iomicoZephyrCourse/zephyr/arch/arc/Kconfig"
```

## twister-out/native_sim_native/host_gnu/app/tests/lib/circularbuffer/lib.circularbuffer/Kconfig/boards/Kconfig
```kconfig
# Load Zephyr board Kconfig descriptions.
osource "/home/strooom/projects/zephyr/iomicoZephyrCourse/zephyr/boards/native/native_sim/Kconfig"
```

## twister-out/native_sim_native/host_gnu/app/tests/lib/circularbuffer/lib.circularbuffer/Kconfig/boards/Kconfig.defconfig
```kconfig
# Load Zephyr board defconfig descriptions.
osource "/home/strooom/projects/zephyr/iomicoZephyrCourse/zephyr/boards/native/native_sim/Kconfig.defconfig"
```

## twister-out/native_sim_native/host_gnu/app/tests/lib/circularbuffer/lib.circularbuffer/Kconfig/boards/Kconfig.native_sim
```kconfig
# Load board Kconfig descriptions.
osource "/home/strooom/projects/zephyr/iomicoZephyrCourse/zephyr/boards/native/native_sim/Kconfig.native_sim"
```

## twister-out/native_sim_native/host_gnu/app/tests/lib/circularbuffer/lib.circularbuffer/Kconfig/boards/Kconfig.sysbuild
```kconfig
# Load Sysbuild board Kconfig descriptions.
osource "/home/strooom/projects/zephyr/iomicoZephyrCourse/zephyr/boards/native/native_sim/Kconfig.sysbuild"
```
